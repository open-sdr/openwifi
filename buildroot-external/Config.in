## buildroot-external/Config.in
```kconfig
menu "OpenWiFi platform"

choice
	prompt "Target board"
	optional

config BR2_OPENWIFI_BOARD_ANTSDR_E200
	bool "ANTSDR-E200"

config BR2_OPENWIFI_BOARD_ANTSDR
	bool "ANTSDR-E310"

config BR2_OPENWIFI_BOARD_E310V2
	bool "ANTSDR-E310V2"

endchoice

config BR2_OPENWIFI_MULTI_BOARD
	bool "Build a shared system image for all supported boards"
	default y if !BR2_OPENWIFI_BOARD_ANTSDR_E200 && !BR2_OPENWIFI_BOARD_ANTSDR && !BR2_OPENWIFI_BOARD_E310V2
	help
	  Build one kernel, module set and root filesystem shared by all
	  supported Zynq-7000 OpenWiFi boards. Board-specific U-Boot, DTB and
	  FPGA files are assembled separately by buildroot-build.sh.

config BR2_OPENWIFI_BOARD_NAME
	string
	default "antsdr_e200" if BR2_OPENWIFI_BOARD_ANTSDR_E200
	default "antsdr" if BR2_OPENWIFI_BOARD_ANTSDR
	default "e310v2" if BR2_OPENWIFI_BOARD_E310V2
	default "multi" if BR2_OPENWIFI_MULTI_BOARD

endmenu

menu "OpenWiFi packages"
	source "$BR2_EXTERNAL_OPENWIFI_PATH/package/libad9361-iio/Config.in"
	source "$BR2_EXTERNAL_OPENWIFI_PATH/package/openwifi/Config.in"
endmenu
```

## buildroot-external/configs/openwifi_common_defconfig
```kconfig
BR2_arm=y
BR2_WGET="$(BR2_EXTERNAL_OPENWIFI_PATH)/board/common/curl-wget"
BR2_cortex_a9=y
BR2_ARM_ENABLE_NEON=y
BR2_ARM_ENABLE_VFP=y
BR2_ARM_EABIHF=y
BR2_TOOLCHAIN_BUILDROOT_MUSL=y
BR2_PACKAGE_HOST_LINUX_HEADERS_CUSTOM_6_12=y
BR2_OPENWIFI_MULTI_BOARD=y
BR2_TARGET_GENERIC_HOSTNAME="openwifi"
BR2_TARGET_GENERIC_ISSUE="OpenWiFi Buildroot shared system"
BR2_TARGET_GENERIC_ROOT_PASSWD="openwifi"
BR2_SYSTEM_DHCP=""
BR2_ROOTFS_OVERLAY="$(BR2_EXTERNAL_OPENWIFI_PATH)/board/common/rootfs-overlay"
BR2_ROOTFS_POST_BUILD_SCRIPT="$(BR2_EXTERNAL_OPENWIFI_PATH)/board/common/post-build.sh"
BR2_PACKAGE_BUSYBOX_SHOW_OTHERS=y
BR2_PACKAGE_BUSYBOX_CONFIG_FRAGMENT_FILES="$(BR2_EXTERNAL_OPENWIFI_PATH)/board/common/busybox-openwifi.fragment"

BR2_LINUX_KERNEL=y
BR2_LINUX_KERNEL_CUSTOM_GIT=y
BR2_LINUX_KERNEL_CUSTOM_REPO_URL="https://github.com/analogdevicesinc/linux.git"
BR2_LINUX_KERNEL_CUSTOM_REPO_VERSION="40201abd70d8f7848547a09fc7e366fba064483c"
BR2_LINUX_KERNEL_USE_CUSTOM_CONFIG=y
BR2_LINUX_KERNEL_CUSTOM_CONFIG_FILE="$(BR2_EXTERNAL_OPENWIFI_PATH)/../kernel_boot/kernel_config"
BR2_LINUX_KERNEL_CONFIG_FRAGMENT_FILES="$(BR2_EXTERNAL_OPENWIFI_PATH)/board/common/linux-minimal.fragment $(BR2_EXTERNAL_OPENWIFI_PATH)/board/common/linux-common.fragment"
BR2_LINUX_KERNEL_PATCH="$(BR2_EXTERNAL_OPENWIFI_PATH)/../kernel_boot/axi_hdmi_crtc.patch $(BR2_EXTERNAL_OPENWIFI_PATH)/../kernel_boot/ad9361_v6_12.patch $(BR2_EXTERNAL_OPENWIFI_PATH)/patches/linux/ad9361-debugfs-capacity.patch $(BR2_EXTERNAL_OPENWIFI_PATH)/../kernel_boot/ad9361_private.patch $(BR2_EXTERNAL_OPENWIFI_PATH)/../kernel_boot/ad9361_conv.patch"
BR2_LINUX_KERNEL_UIMAGE=y
BR2_LINUX_KERNEL_UIMAGE_LOADADDR="0x8000"
BR2_LINUX_KERNEL_DTS_SUPPORT=y
BR2_LINUX_KERNEL_INTREE_DTS_NAME="xilinx/antsdr_e200 xilinx/antsdr xilinx/e310v2"
BR2_LINUX_KERNEL_NEEDS_HOST_OPENSSL=y

BR2_TARGET_ROOTFS_EXT2=y
BR2_TARGET_ROOTFS_EXT2_4=y
BR2_TARGET_ROOTFS_EXT2_LABEL="rootfs"
BR2_TARGET_ROOTFS_EXT2_SIZE="96M"

BR2_TARGET_UBOOT=y
BR2_TARGET_UBOOT_BUILD_SYSTEM_KCONFIG=y
BR2_TARGET_UBOOT_CUSTOM_TARBALL=y
BR2_TARGET_UBOOT_CUSTOM_TARBALL_LOCATION="$(call github,Xilinx,u-boot-xlnx,xlnx_rebase_v2024.01_2024.2)/xlnx_rebase_v2024.01_2024.2.tar.gz"
BR2_TARGET_UBOOT_BOARD_DEFCONFIG="xilinx_zynq_virt"
BR2_TARGET_UBOOT_CONFIG_FRAGMENT_FILES="$(BR2_EXTERNAL_OPENWIFI_PATH)/board/common/uboot.fragment"
BR2_TARGET_UBOOT_CUSTOM_DTS_PATH="$(OPENWIFI_GENERATED_DIR)/devicetree.dts"
BR2_TARGET_UBOOT_PATCH="$(OPENWIFI_GENERATED_DIR)/uboot-patches"
BR2_TARGET_UBOOT_NEEDS_DTC=y
BR2_TARGET_UBOOT_NEEDS_OPENSSL=y
BR2_TARGET_UBOOT_NEEDS_GNUTLS=y
BR2_TARGET_UBOOT_FORMAT_IMG=y
BR2_TARGET_UBOOT_SPL=y
BR2_TARGET_UBOOT_SPL_NAME="spl/boot.bin"

BR2_PACKAGE_BASH=y
BR2_PACKAGE_DROPBEAR=y
BR2_PACKAGE_DROPBEAR_DISABLE_REVERSEDNS=y
BR2_PACKAGE_IW=y
BR2_PACKAGE_WIRELESS_TOOLS=y
BR2_PACKAGE_WIRELESS_TOOLS_IWCONFIG=y
BR2_PACKAGE_HOSTAPD=y
BR2_PACKAGE_HOSTAPD_DRIVER_NL80211=y
BR2_PACKAGE_WPA_SUPPLICANT=y
BR2_PACKAGE_WPA_SUPPLICANT_NL80211=y
BR2_PACKAGE_WPA_SUPPLICANT_CLI=y
BR2_PACKAGE_DHCP=y
BR2_PACKAGE_DHCP_SERVER=y
BR2_PACKAGE_DHCP_CLIENT=y
BR2_PACKAGE_IPROUTE2=y
BR2_PACKAGE_ETHTOOL=y
BR2_PACKAGE_IPERF3=y
BR2_PACKAGE_TCPDUMP=y
BR2_PACKAGE_BATCTL=y
BR2_PACKAGE_LIBNL=y
BR2_PACKAGE_LIBNL_TOOLS=y
BR2_PACKAGE_LIBPCAP=y
BR2_PACKAGE_LIBIIO=y
BR2_PACKAGE_LIBIIO_LOCAL_BACKEND=y
BR2_PACKAGE_LIBIIO_XML_BACKEND=y
BR2_PACKAGE_LIBIIO_NETWORK_BACKEND=y
BR2_PACKAGE_LIBIIO_TESTS=y
BR2_PACKAGE_LIBIIO_IIOD=y
BR2_PACKAGE_LIBAD9361_IIO=y
BR2_PACKAGE_WIRELESS_REGDB=y
BR2_PACKAGE_OPENWIFI=y

BR2_PACKAGE_HOST_BOOTGEN=y
BR2_PACKAGE_HOST_UBOOT_TOOLS=y
BR2_PACKAGE_HOST_DOSFSTOOLS=y
BR2_PACKAGE_HOST_GENIMAGE=y
BR2_PACKAGE_HOST_MTOOLS=y
```

## buildroot-external/package/libad9361-iio/Config.in
```kconfig
config BR2_PACKAGE_LIBAD9361_IIO
	bool "libad9361-iio"
	select BR2_PACKAGE_LIBIIO
	help
	  Analog Devices AD9361 helper library built on top of libiio.

	  This provides the user-space clock-chain, filter and multi-chip
	  synchronization helpers used by AD9361 applications.
```

## buildroot-external/package/openwifi/Config.in
```kconfig
config BR2_PACKAGE_OPENWIFI
	bool "openwifi driver and user-space tools"
	depends on BR2_LINUX_KERNEL
	select BR2_PACKAGE_BASH
	select BR2_PACKAGE_LIBNL
	select BR2_PACKAGE_LIBPCAP
	help
	  Build the OpenWiFi mac80211 modules and target-side tools from
	  the source repository containing this Buildroot external tree.
```
